## config/west.yml
```yaml
manifest:
  remotes:
    - name: zmkfirmware
      url-base: https://github.com/zmkfirmware
    - name: ShiniNet
      url-base: https://github.com/ShiniNet/
    - name: caksoylar
      url-base: https://github.com/caksoylar
    - name: ssbb
      url-base: https://github.com/ssbb
    - name: kot149
      url-base: https://github.com/kot149
    - name: halfdane
      url-base: https://github.com/halfdane
  projects:
    # https://github.com/zmkfirmware/zmk
    - name: zmk
      remote: zmkfirmware
      revision: main
      import: app/west.yml
    # https://github.com/halfdane/cirque-input-module
    - name: cirque-input-module
      remote: halfdane
      revision: absolute_mode
      path: modules/cirque-input-module
    # https://github.com/ssbb/zmk-listeners
    - name: zmk-listeners
      remote: ssbb
      revision: v1
      path: modules/zmk-listeners
    # https://github.com/caksoylar/zmk-rgbled-widget
    - name: zmk-rgbled-widget
      remote: caksoylar
      revision: main
      path: modules/zmk-rgbled-widget
    # https://github.com/kot149/zmk-mouse-gesture
    - name: zmk-mouse-gesture
      remote: kot149
      revision: v1
      path: modules/zmk-mouse-gesture
    # https://github.com/kot149/zmk-layout-shift
    - name: zmk-layout-shift
      remote: kot149
      revision: v1
      path: modules/zmk-layout-shift
    # https://github.com/halfdane/zmk-input-processors
    - name: zmk-input-processors
      remote: halfdane
      revision: main
      path: modules/zmk-input-processors
    # https://github.com/halfdane/zmk-input-gestures
    - name: zmk-input-gestures
      remote: halfdane
      revision: main
      path: modules/zmk-input-gestures
  self:
    path: config
```
